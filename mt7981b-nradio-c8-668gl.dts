/dts-v1/;

#include "mt7981b.dtsi"

/ {
	model = "NRadio C8-668GL / C8-688";
	compatible = "nradio,c8-668gl", "mediatek,mt7981";

	chosen {
		bootargs = "console=ttyS0,115200n8 default_hugepagesz=2m root=PARTLABEL=rootfs_2nd rootwait rootfstype=squashfs,f2fs";
	};
};
